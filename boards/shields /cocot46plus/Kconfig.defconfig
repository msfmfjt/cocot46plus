## boards/shields /cocot46plus/Kconfig.defconfig
```kconfig
if SHIELD_COCOT46PLUS

# Name must be less than 16 characters long!
config ZMK_KEYBOARD_NAME
    default "Cocot46 Plus"

endif
```

## boards/shields/cocot46plus/Kconfig.defconfig
```kconfig
if SHIELD_COCOT46PLUS

config ZMK_KEYBOARD_NAME
    default "Cocot46 Plus"

endif
```

## config/west.yml
```yaml
manifest:
  remotes:
    - name: zmkfirmware
      url-base: https://github.com/zmkfirmware
    - name: sekigon-gonnoc
      url-base: https://github.com/sekigon-gonnoc
    # - name: msfmfjt
    #   url-base: https://github.com/msfmfjt
  projects:
    - name: zmk
      remote: zmkfirmware
      revision: v0.2.1
      import: app/west.yml
    - name: zmk-component-bmp-boost
      remote: sekigon-gonnoc
      import: west.yml
    # - name: zmk-adns5050-driver
    #   remote: msfmfjt
    #   revision: main
  self:
    path: config
```
